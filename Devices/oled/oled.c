#include "oled.h"
#include "spi.h"
#include "stm32f446xx.h"
#include <string.h>

// DC pin  = PA3 (HIGH = data, LOW = command)
// RES pin = PA2 (active low reset)
// CS pin  = PA4 (managed in spi.c)

static uint8_t framebuf[OLED_WIDTH * (OLED_HEIGHT / 8)];

static const uint8_t font5x7[][5] = {
	    {0x00,0x00,0x00,0x00,0x00}, // space
	    {0x00,0x00,0x5F,0x00,0x00}, // !
	    {0x00,0x07,0x00,0x07,0x00}, // "
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	    {0x08,0x08,0x2A,0x1C,0x08}, // ~
	};

static void dc_res_init(void)
{
    // 1. configure PA2 (RES) as GPIO output in MODER
    GPIOA->MODER &= ~(3U << (2*2));
    GPIOA->MODER |=  (1U << (2*2));

    // 2. configure PA3 (DC) as GPIO output in MODER
    GPIOA->MODER &= ~(3U << (2*3));
    GPIOA->MODER |=  (1U << (2*3));

    // 3. set RES high using BSRR
    GPIOA->BSRR = (1U << 2);

    // 4. set DC high using BSRR
    GPIOA->BSRR = (1U << 3);
}

static void write_cmd(uint8_t cmd)
{
    // 1. pull DC low (command mode)
    GPIOA->BSRR = (1U << (3 + 16));

    // 2. select OLED CS
    spi_select_oled();

    // 3. transmit cmd byte
    spi_transmit(cmd);

    // 4. deselect OLED CS
    spi_deselect_oled();
}

static void write_data(uint8_t data)
{
    // 1. pull DC high (data mode)
    GPIOA->BSRR = (1U << 3);

    // 2. select OLED CS
    spi_select_oled();

    // 3. transmit data byte
    spi_transmit(data);

    // 4. deselect OLED CS
    spi_deselect_oled();
}

static void delay_ms_simple(uint32_t ms)
{
    for (uint32_t i = 0; i < ms * 8000; i++) __NOP();
}

void oled_init(void)
{
    // 1. call dc_res_init()
    dc_res_init();

    // 2. hardware reset: pull RES low, delay ~10ms, pull RES high, delay ~10ms
    GPIOA->BSRR = (1U << (2 + 16));
    delay_ms_simple(10);
    GPIOA->BSRR = (1U << 2);
    delay_ms_simple(10);

    // 3. send init command sequence
    write_cmd(0xAE);
    write_cmd(0x20); write_cmd(0x00);
    write_cmd(0xB0);
    write_cmd(0xC8);
    write_cmd(0x00);
    write_cmd(0x10);
    write_cmd(0x40);
    write_cmd(0x81); write_cmd(0x7F);
    write_cmd(0xA1);
    write_cmd(0xA6);
    write_cmd(0xA8); write_cmd(0x3F);
    write_cmd(0xA4);
    write_cmd(0xD3); write_cmd(0x00);
    write_cmd(0xD5); write_cmd(0xF0);
    write_cmd(0xD9); write_cmd(0x22);
    write_cmd(0xDA); write_cmd(0x12);
    write_cmd(0xDB); write_cmd(0x20);
    write_cmd(0x8D); write_cmd(0x14);
    write_cmd(0xAF);

    // 4. clear framebuffer and flush
    oled_clear();
    oled_update();
}

void oled_clear(void)
{
    memset(framebuf, 0, sizeof(framebuf));
}

void oled_update(void)
{
    // 1. set column address range 0-127
    write_cmd(0x21); write_cmd(0); write_cmd(127);

    // 2. set page address range 0-7
    write_cmd(0x22); write_cmd(0); write_cmd(7);

    // 3. pull DC high (data mode)
    GPIOA->BSRR = (1U << 3);

    // 4. select OLED CS
    spi_select_oled();

    // 5. loop over all bytes in framebuf and transmit
    for (uint16_t i = 0; i < sizeof(framebuf); i++) {
        spi_transmit(framebuf[i]);
    }

    // 6. deselect OLED CS
    spi_deselect_oled();
}

void oled_draw_string(uint8_t col, uint8_t row, const char *str)
{
    while (*str) {
        char c = *str++;
        if (c < 0x20 || c > 0x7E) c = ' ';

        uint16_t offset = (uint16_t)row * OLED_WIDTH + (uint16_t)col * 6;

        for (uint8_t i = 0; i < 5; i++) {
            framebuf[offset + i] = font5x7[(uint8_t)(c - 0x20)][i];
        }
        framebuf[offset + 5] = 0x00;

        if (++col >= 21) { col = 0; row++; }
    }
}


